// DrumSynth

#include <Arduino.h>
#include <Mux.h>
#include <ResponsiveAnalogRead.h>
#include <ShiftRegister74HC595.h>
#include <Adafruit_GFX.h>
#include <Adafruit_SH110X.h>
#include <EEPROM.h>
#include <Fonts/Picopixel.h>  // 3×5 Adafruit GFX font for overlay labels

// Audio objects: names generated by the Teensy Audio Design Tool (https://www.pjrc.com/teensy/gui/).
// Prefix convention: d1/d2/d3 = drum voice, clap/snare = sub-voice, master = output stage.
#include "audiotool.h"

// D1 envelope attack — defined before audio_init.h so audioInit() can use it.
static constexpr float D1_ATTACK_MS = 0.5f;  // 808-style instant punch — fixed, not knob-controlled

#include "audio_init.h"
#include "bitmaps.h"
#include "hw_setup.h"

// Forward declaration for Arduino auto-prototype generation.
// Full definition is in the button state machine section below.
struct ButtonHandler;

static constexpr const char* FIRMWARE_VERSION   = "1.07";

// Track enum — declared early so Arduino auto-prototypes can reference it
enum Track : uint8_t {
  TRACK_D1 = 0,
  TRACK_D2 = 1,
  TRACK_D3 = 2
};

// overlay and debounce timing
static constexpr uint16_t PARAMETER_OVERLAY_DURATION_MS = 500;
static constexpr uint16_t SHUFFLE_OVERLAY_DURATION_MS  = 800;
static constexpr uint16_t STEP_DEBOUNCE_MS = 10;        // 10ms — fast response for sync (step buttons only)
static constexpr uint16_t MONOBASS_DEBOUNCE_MS = 10;   // 10ms — reliable debounce with fast trill response
static bool monoBassKeyEvent = false;                   // set by handleMonoBassButton() to skip next OLED frame
static constexpr uint16_t PLAY_DEBOUNCE_MS = 2;       // Play button: minimal debounce for tight sync
static constexpr uint16_t BUTTON_DEBOUNCE_MS = 25;    // All other buttons: standard debounce
static constexpr float    WF_DEADBAND = 0.03f;        // wavefolder off below 3% — used by all wavefolder cases (11, 19, 30)

// Remap a normalized knob value above WF_DEADBAND to 0–1.
// Returns 0 when norm <= deadband, linear 0→1 above it.
static inline float wfActive(float norm) {
  if (norm <= WF_DEADBAND) return 0.0f;
  return (norm - WF_DEADBAND) / (1.0f - WF_DEADBAND);
}

// D3 accent LED preview state — Main-loop only, no ISR access
struct AccentPreview {
  bool active = false;
  uint32_t startTick = 0;
  uint16_t mask = 0;  // bit15 = step0 ... bit0 = step15
};
AccentPreview accentPreview;
static constexpr uint16_t ACCENT_PREVIEW_DURATION_MS = 1500;

// PPQN selection mode state — main-loop only
bool ppqnModeActive = false;
uint32_t ppqnModeLastActivityTick = 0;  // Last knob/button interaction
uint8_t ppqnModeSelection = 2;          // Currently selected value in mode
static constexpr uint32_t PPQN_MODE_TIMEOUT_MS = 5000;
static constexpr uint32_t PPQN_LONG_PRESS_MS = 1500;

// PPQN options table
static constexpr uint8_t PPQN_OPTIONS[] = {1, 2, 4, 8, 24, 48, 96};
static constexpr uint8_t PPQN_OPTION_COUNT = sizeof(PPQN_OPTIONS) / sizeof(PPQN_OPTIONS[0]);

// Combo button (MEM) timing — combo button is purely a modifier, no short press action.
// Any button pressed while combo is held fires a combo immediately.
static constexpr uint32_t COMBO_OVERLAY_DELAY_MS = 300;   // delay before help overlay appears (suppress flash on quick combos)
static constexpr uint32_t COMBO_MONO_ANIM_MS     = 3500;  // MONOBASS warning animation starts
static constexpr uint32_t COMBO_MONO_ENTER_MS    = 8000;  // MONOBASS mode enters/exits
// PPQN mode: combo short press cycles, combo long press saves
static constexpr uint32_t PPQN_SAVE_HOLD_MS      = 1500;

// D1 chroma mode state — main-loop only
bool d1ChromaMode = false;

// MONOBASS mode — see monobass.h (included after forward declarations).

// D2 chroma mode — toggled via X+D2 combo
bool d2ChromaMode = false;

// D3 chroma mode — toggled via X+D3 combo
bool d3ChromaMode = false;

// Wavefolder CHROMA mode — toggled via X+PLAY combo
bool wfChromaMode = false;

// Shuffle state (TR-909 style, 6 audible settings + OFF)
// Delay ticks are on a 96-PPQN grid: each 16th = 24 ticks.
// Even 16th notes are delayed by kShuffleDelayTicks[mode] ticks.
// SHUFFLE_1 (0 ticks) is kept in the enum/tables for EEPROM backward
// compat but skipped when cycling — it's identical to OFF.
enum ShuffleMode : uint8_t {
  SHUFFLE_OFF = 0, SHUFFLE_1, SHUFFLE_2, SHUFFLE_3,
  SHUFFLE_4, SHUFFLE_5, SHUFFLE_6, SHUFFLE_7
};
static volatile ShuffleMode shuffleMode = SHUFFLE_OFF;
static constexpr uint8_t kShuffleDelayTicks[8] = { 0, 0, 2, 4, 6, 8, 10, 12 };
// Index 1 (SHUFFLE_1) is kept for EEPROM backward compat — identical to OFF (50%).
static constexpr uint8_t kShufflePercent[8]    = { 50, 50, 54, 58, 63, 67, 71, 75 };
static uint32_t shuffleOverlayStartTick = 0;   // big shuffle display trigger (0 = inactive)
static char     shuffleOverlayText[16]  = "";   // cached label: "OFF" or "3 / 58%"

// Bayer 4×4 ordered dithering — returns true if pixel (x,y) should be ON
// at the given density (0.0 = all off, 1.0 = all on).
static const uint8_t kBayer4[4][4] = {
  { 0, 8, 2,10},
  {12, 4,14, 6},
  { 3,11, 1, 9},
  {15, 7,13, 5}
};
static inline bool bayerDither(int x, int y, float density) {
  return density > (float)kBayer4[y & 3][x & 3] / 16.0f;
}

// Chroma dot animation state — helpers and pitch tables in chroma.h.
enum ChromaAnimPhase : uint8_t {
  CHROMA_ANIM_NONE = 0,
  CHROMA_ANIM_RAMPING,    // progressive Bayer dither fill
  CHROMA_ANIM_SETTLING    // snap to steady state
};
int8_t chromaAnimDot = -1;
ChromaAnimPhase chromaAnimPhase = CHROMA_ANIM_NONE;
uint32_t chromaAnimStart = 0;
bool chromaAnimAppearing = true;

// MONOBASS text animation — plays during X hold from 1.75s-3s.
enum MonoAnimPhase : uint8_t {
  MONO_ANIM_NONE = 0,
  MONO_ANIM_ENTERING,
  MONO_ANIM_EXITING
};

static MonoAnimPhase monoAnimPhase = MONO_ANIM_NONE;
static uint32_t monoAnimStart = 0;
static constexpr uint32_t MONO_ANIM_DURATION_MS = 4000;  // fits within 3500→8000 window

// Precomputed text mask for MONOBASS white-fill sweep animation.
// Computed once in setup() since it depends on the font renderer.
static constexpr int kMonoTextX = 16;  // (128 - 96) / 2
static constexpr int kMonoTextY = 2;
static constexpr int kMonoTextW = 96;  // 8 chars × 12px at size 2
static constexpr int kMonoTextH = 14;  // 7 rows × 2 at size 2 (y=2..15)
// Sweep region: 1px symmetrical buffer around visible text, y=0 to y=17
static constexpr int kSweepLeftX = kMonoTextX - 1;       // 15 (1px before 'M')
static constexpr int kSweepRightX = kMonoTextX + kMonoTextW; // 112 (1px past last text column)
static constexpr int kSweepW = kSweepRightX - kSweepLeftX; // 97
static constexpr int kSweepRegionH = 18;     // y < 18, 1px gap above divider at y=19
static constexpr int kSweepTransitionW = 16;  // Bayer-dithered soft edge width in pixels
// Text bitmask: 1 bit per pixel in the text region (kMonoTextW × kMonoTextH = 96×14)
// Stored as packed bytes: ceil(1344 / 8) = 168 bytes
static uint8_t monoTextMask[168];
static bool monoMasksReady = false;

static void cancelMonoAnim();

static constexpr uint32_t CHROMA_STEP_HOLD_MS = 300;  // Hold step button this long to select note
int8_t d1ChromaHeldStep = -1;  // Which step button is held (-1 = none)
int8_t d2ChromaHeldStep = -1;  // Which step is in D2 chroma note-select (-1 = none)
int8_t d3ChromaHeldStep = -1;  // Which step is in D3 chroma note-select (-1 = none)

// Per-step MIDI note for D1 chroma (A1=33 to A4=69, 36 semitones)
// Default C2 = MIDI 36
uint8_t d1ChromaNote[numSteps] = {
  36,36,36,36, 36,36,36,36, 36,36,36,36, 36,36,36,36
};

// Per-step MIDI note for D2 chroma (A2=45 to A4=69, 24 semitones)
// Default C3 = MIDI 48
uint8_t d2ChromaNote[numSteps] = {
  48,48,48,48, 48,48,48,48, 48,48,48,48, 48,48,48,48
};

// Per-step MIDI note for D3 chroma (C3=48 to C6=84, 36 semitones)
// Default C3 = MIDI 48
uint8_t d3ChromaNote[numSteps] = {
  48,48,48,48, 48,48,48,48, 48,48,48,48, 48,48,48,48
};

// --- Sequences ---

uint8_t d1Sequence[numSteps] = {
  0, 0, 0, 0,
  0, 0, 0, 0,
  0, 0, 0, 0,
  0, 0, 0, 0
};

uint8_t d2Sequence[numSteps] = {
  0, 0, 0, 0,
  0, 0, 0, 0,
  0, 0, 0, 0,
  0, 0, 0, 0
};

uint8_t d3Sequence[numSteps] = {
  0, 0, 0, 0,
  0, 0, 0, 0,
  0, 0, 0, 0,
  0, 0, 0, 0
};

// --- Timing, Tempo, and Transport ---

IntervalTimer sysTickTimer;
IntervalTimer stepTimer;

// Written by sysTickISR every 1ms, read by main loop.
// Single aligned 32-bit reads are atomic on Cortex-M7, so a lone read is safe
// without noInterrupts(). Use noInterrupts() only when snapshotting multiple
// ISR variables that must be consistent together.
volatile uint32_t sysTickMs = 0;

static void cancelMonoAnim() {
  monoAnimPhase = MONO_ANIM_NONE;
}

// Precompute text and outline masks for MONOBASS dither animation.
// Must be called once in setup() after display.begin() / clearDisplay().
void precomputeMonoMasks() {
  memset(monoTextMask, 0, sizeof(monoTextMask));

  // Render text to display buffer to capture pixel positions
  display.fillRect(kMonoTextX, kMonoTextY, kMonoTextW, kMonoTextH, SH110X_BLACK);
  display.setTextSize(2);
  display.setTextColor(SH110X_WHITE);
  display.setCursor(kMonoTextX, kMonoTextY);
  display.print("MONOBASS");

  // Read back pixels into text mask
  for (int y = 0; y < kMonoTextH; y++) {
    for (int x = 0; x < kMonoTextW; x++) {
      if (display.getPixel(kMonoTextX + x, kMonoTextY + y)) {
        int bit = y * kMonoTextW + x;
        monoTextMask[bit >> 3] |= (1 << (bit & 7));
      }
    }
  }

  // Clear the rendering we used for mask capture
  display.fillRect(kMonoTextX, kMonoTextY, kMonoTextW, kMonoTextH, SH110X_BLACK);
  display.setTextSize(1);
  monoMasksReady = true;
}

// bpm: main-loop writes (knob handler), ISR reads via shuffledStepPeriodUs().
// 32-bit float read is atomic on Cortex-M7 (single LDR).
volatile float bpm = 120.0f;
// currentStep: ISR-written (stepISR, externalClockISR, subdivTimerCallback),
// main loop reads. See concurrency contract in ext_sync.h.
volatile uint8_t currentStep = 0;

// Three states: internal clock, external clock, or stopped
enum TransportState : uint8_t {
  STOPPED   = 0,
  RUN_INT   = 1,   // Internal timer drives steps
  RUN_EXT   = 2    // External pulse ISR drives steps
};

volatile TransportState transportState = STOPPED;  // Read by stepISR, externalClockISR
volatile bool sequencePlaying = false;     // Read by stepISR, externalClockISR
volatile bool armed = false;              // PLAY sets true; ISR counts down then fires step 0
volatile uint16_t armPulseCountdown = 0;  // Pulses remaining before step 0 fires (one full cycle)

// PPQN for external clock — loaded from EEPROM at boot, selectable via UI.
// ISR reads (externalClockISR), main loop writes (PPQN selection mode).
// uint8_t is atomic on ARM Cortex-M7 — no interrupt guards needed.
static constexpr uint8_t PPQN_DEFAULT = 2;  // shared with eeprom.h fallback
volatile uint8_t ppqn = PPQN_DEFAULT;

// Minimum interval between retriggering the same voice (µs).
// Avoids noteOff() killing a just-triggered envelope when two steps fire
// in rapid succession (e.g. skip-ahead fires step N then subdivision fires N+1).
static constexpr uint32_t MIN_RETRIGGER_US = 1500;

// Per-voice retrigger timestamps — main loop only (via playSequenceCore)
uint32_t lastD1TriggerUs = 0;
uint32_t lastD2TriggerUs = 0;
uint32_t lastD3TriggerUs = 0;

// ---------------------------------------------------------------------------
// Mid-file includes: These headers define functions/ISRs that reference globals
// declared above. Arduino IDE compiles .ino as a single translation unit, so
// these headers act as inline code segments rather than independent modules.
// ---------------------------------------------------------------------------

// External clock sync — ISRs, state variables, glitch filter, EMA, helpers
// (depends on: TransportState, stepTimer, bpm, ppqn, playSequenceCore, currentStep)
#include "ext_sync.h"

// OLED watchdog and frame timing
// Written: main loop (updateDisplay). Read: sysTickISR (watchdog), main loop (frame limiter).
volatile uint32_t lastFrameDrawTick = 0;
static constexpr uint32_t OLED_WATCHDOG_TIMEOUT_MS = 750;
static constexpr uint32_t OLED_FRAME_INTERVAL_MS = 42;        // ~24 fps
static constexpr uint32_t OLED_FRAME_INTERVAL_EXT_MS = 100;   // ~10 fps (ext sync — fewer frames = less CPU contention)
static constexpr uint32_t OLED_SUBDIV_GUARD_US = 5000;       // Skip entire OLED frame if subdivision due within 5ms (see note below)
static constexpr int32_t  OLED_GUARD_US        = 3000;       // Skip page push start if step due within 3ms (~one page)
volatile bool requestOledReinit = false;  // Set by sysTickISR, cleared by main loop
uint32_t displayBlockedUntilTick = 0;       // Suppress OLED push after drop-in (main-loop only)

// Oscilloscope — scope buffer, updateScopeData(), drawScopeWaveform()
#include "oscilloscope.h"

// --- Decay and Envelope State ---

// Base decay values (raw knob position, before choke offset)
float d1DecayBase = 75.0f;
float d2DecayBase = 75.0f;
float d2DecayNorm = 0.0f;  // 0–1 knob position, used by clap curves
float d3DecayBase = 25.0f;

// Effective decays (base + choke offset, updated by applyChokeToDecays)
float d1EffectiveDecay = 75.0f;
float d2ClapEffectiveDecay = 60.0f;  // Derived from d2DecayBase via normalized mapping
float d3EffectiveDecay = 25.0f;       // Includes accent boost when accent mode active

// Global choke offset
int chokeOffsetMs = 0;
int chokeDisplayPercent = 0;  // -100 to +100, for top bar and overlay display

// D1 envelope params (D1_ATTACK_MS defined above audio_init.h include)
float d1CachedHoldMs = 56.25f;               // scales with decay; see updateD1HoldCache()

// --- Display State (main-loop only, no ISR access) ---

// Parameter overlay text
char displayParameter1[24] = "";
char displayParameter2[24] = "";
uint32_t parameterOverlayStartTick = 0;

// Voice rail caret positions
float uiMixD1Shape = 0.0f;
float uiMixD2Voice = 0.0f;
float uiMixD3Voice = 0.0f;

enum RailMode : uint8_t {
  RAIL_NONE = 0,
  RAIL_D1_SHAPE,
  RAIL_D2_VOICE,
  RAIL_D3_VOICE
};

RailMode activeRail = RAIL_NONE;

// EEPROM persistence — structs, constants, save/load functions
// (must be included after sequences, ppqn, PPQN_OPTIONS, RailMode, UI overlay vars)
#include "eeprom.h"

// delay ratios (in quarter-note units)
static constexpr float quantizeRatios[] = {
  0.25f,        // 1/4  of a quarter  = 1/16
  0.33333333f,  // 1/3  of a quarter  = 1/8T
  0.375f,       // 3/8  of a quarter  = 1/16.
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  2.5f,         // 5/2  quarters     = 5/8
  3.0f          // 3    quarters     = 1/2.
};

static constexpr const char* ratioLabels[] = {
  "1/16",
  "1/8T",
  "1/16.",
  "1/8",
  "1/4T",
  "1/8.",
  "1/4",
  "5/16",
  "1/2T",
  "1/4.",
  "1/2",
  "5/8",
  "1/2."
};

static constexpr int NUM_RATIOS = sizeof(quantizeRatios) / sizeof(quantizeRatios[0]);
static_assert(sizeof(ratioLabels) / sizeof(ratioLabels[0]) == NUM_RATIOS,
              "ratioLabels must match quantizeRatios count");

// master gain
float masterNominalGain = 1.0f;

// drum levels
float d1Volume = 0.65f;
float d2Volume = 1.25f;
float d3Volume = 0.75f;

// delay sends
float d1DelaySend = 0.0f;
float d2DelaySend = 0.0f;
float d3DelaySend = 0.0f;

// accents
enum AccentMode : uint8_t {
  ACCENT_OFF = 0,
  ACCENT_PICKUP,
  ACCENT_HALF,
  ACCENT_QUARTER,
  ACCENT_EIGHTH_DOWN,
  ACCENT_EIGHTH_UP,
  ACCENT_BOSSA,
  ACCENT_OFFBEAT,
  ACCENT_CLAVE,
  ACCENT_THREE_TWO,
  ACCENT_PAIRS,
  ACCENT_TRIPLET,
  ACCENT_DOTTED_EIGHTH,
  ACCENT_BACK_HALF,
  ACCENT_CASCADE
};

static constexpr const char* accentNames[] = {
  "OFF", "PICKUP", "HALF", "QUARTER", "8TH DN", "8TH UP",
  "BOSSA", "OFFBEAT", "CLAVE", "3-2", "PAIRS",
  "TRIPLET", "DOT 8TH", "BACK 1/2", "CASCADE"
};
static_assert(sizeof(accentNames) / sizeof(accentNames[0]) == ACCENT_CASCADE + 1,
              "accentNames must match AccentMode enum count");

uint8_t d3AccentMode = ACCENT_OFF;
uint16_t d3AccentMask = 0;  // Cached: accentMaskFromMode(d3AccentMode), updated on accent knob change

// Accented hi-hat decay multiplier (2.5x longer decay on accent steps)
static constexpr float D3_ACCENT_FACTOR = 2.5f;


Track activeTrack = TRACK_D1;  // Main-loop only — no ISR access

// knob smoothing
ResponsiveAnalogRead* analog[knobCount];

// Knob precision tuning — adjust on hardware (testPotResolution branch)
static constexpr uint8_t  KNOB_HW_AVG          = 8;     // Hardware ADC averaging (1, 4, 8, 16, 32)
static constexpr uint8_t  KNOB_MUX_SETTLE_US   = 10;    // Mux settle time (µs) after channel switch (was 5)
static constexpr uint8_t  KNOB_OVERSAMPLE      = 4;     // Software ADC reads to average (1 = none, 4 = 2× noise reduction)
static constexpr int      KNOB_ACTIVITY_THRESH  = 10;    // RAR activity threshold (was 36; lower = finer, noisier)
static constexpr float    KNOB_SNAP_MULTI       = 0.01f; // RAR snap multiplier (default 0.01; higher = faster tracking)

// Boot-lock: suppress knob updates until user intentionally moves a knob.
// Prevents ADC drift on power-up from changing parameter values.
static int16_t knobBootValue[knobCount];   // ADC value at boot (after filter settles)
static bool    knobUnlocked[knobCount];    // true once the user has moved this knob
static constexpr int KNOB_UNLOCK_THRESHOLD = 10;  // ADC counts of intentional movement

// helpers
static inline float mapFloat(int inputValue, int inMin, int inMax, float outMin, float outMax) {
  if (inMax == inMin) return outMin;  // guard: avoid divide-by-zero
  return outMin + (outMax - outMin) * float(inputValue - inMin) / float(inMax - inMin);
}

static inline float normalizeKnob(int rawKnobValue) {
  return float(rawKnobValue) / 1023.0f;
}

// D1 osc and pitch
float d1BaseFreq = 100.0f;
float d1FreqBeforeChroma = 100.0f;  // saved on D1 chroma entry, restored on exit

// D1 chroma envelope filter state (snap knob repurposed, mirrors MONOBASS logic)
float d1ChromaEnvFiltDepth = 0.0f;    // 0–1 from snap knob
float d1ChromaEnvFiltBaseHz = 100.0f; // resting cutoff cached from body knob
uint32_t d1ChromaEnvFiltTrigger = 0;  // sysTickMs of last D1 trigger in chroma mode

void applyD1Freq() {
  AudioNoInterrupts();
  d1OscSine.frequency(d1BaseFreq);
  d1OscSaw.frequency(d1BaseFreq);
  d1OscSquare.frequency(d1BaseFreq);
  AudioInterrupts();
}

// choke mapping helper
static inline int chokeOffsetFromKnob(int knobVal) {
  const int CENTER = 512;
  const int DEADBAND = 80;
  const int MAX_NEG = -55;
  const int MAX_POS = 150;

  // Deadband: center ±80 ADC counts → offset 0ms
  if (knobVal >= CENTER - DEADBAND && knobVal <= CENTER + DEADBAND) {
    return 0;
  }

  // Left of deadband: full CCW → -55ms
  if (knobVal < CENTER - DEADBAND) {
    int lowEnd = CENTER - DEADBAND;  // also the full range [0, lowEnd]
    float blend = float(lowEnd - knobVal) / float(lowEnd);
    return (int)(MAX_NEG * blend);
  }

  // Right of deadband: full CW → +150ms
  int highStart = CENTER + DEADBAND;
  float blend = float(knobVal - highStart) / float(1023 - highStart);
  return (int)(MAX_POS * blend);
}

// D3 effective decay (includes choke and accent boost, capped at 250ms)
static inline float computeD3Decay() {
  float base = d3DecayBase + chokeOffsetMs;
  if (base < 15.0f) base = 15.0f;
  if (d3AccentMode != ACCENT_OFF) base += 7.0f;
  if (base > 250.0f) base = 250.0f;
  return base;
}


// sequence routing
uint8_t* sequenceForTrack(Track t) {
  switch (t) {
    case TRACK_D1: return d1Sequence;
    case TRACK_D2: return d2Sequence;
    case TRACK_D3: return d3Sequence;
    default:       return d1Sequence;  // unreachable — all Track values handled above
  }
}

// forward declarations
void updateOtherButtons();
void updateStepButtons();
void updateLEDs();
void updateDisplay();
void selectTrack(Track t);
void playSequence();
void playSequenceCore(uint8_t step);
void triggerD1();
void triggerD2();
void triggerD3(uint8_t step);
int readKnobRaw(uint8_t idx);
void updateParameterDisplay(uint8_t idx, int knobValue);
void applyKnobToEngine(uint8_t idx, int knobValue);
void updateKnobs();
void setTransport(TransportState s);
void updateDrumDelayGains();
void initKnobsFromHardware();
static void flashStepLed(uint8_t stepIndex, uint8_t count);
void applyMasterGain();
void handlePlayStop();
void applyD1Decay();
void applyD2Decay();
void applyD3Decay();
void applyChokeToDecays();
void drawOutlinedText(int x, int y, const char* text);
bool isSafeToPushOled(uint32_t nowMs);

// Shared constant: envelope filter ceiling used by both chroma and MONOBASS.
static constexpr float kEnvFiltCeiling = 8000.0f;

// Chroma — MIDI pitch tables, note conversion, envelope filter, dot animation.
// Depends on: audiotool.h, chroma state vars (defined above).
#include "chroma.h"

// MONOBASS — struct, constants, entry/exit, keyboard handler, display renderer.
// Included here because it depends on forward declarations above and state
// variables like D1_ATTACK_MS, TransportState, d1EffectiveDecay, etc.
#include "monobass.h"
MonoBassState monoBass;

// Splash dissolve state — used by splash.h (Phase 1 setup) and
// display_ui.h (Phase 2 overlay in updateDisplay).
bool splashDissolveActive = false;
uint32_t splashDissolveStartMs = 0;
uint8_t splashCapture[1024];  // captured splash framebuffer

// Splash animation — version display with Bayer dissolve into idle UI.
#include "splash.h"

// X-Combo help overlay — full-screen spatial diagram (header, circles, step buttons).
// Depends on: Picopixel font, display, isSafeToPushOled().
#include "xcombo_overlay.h"

// Button handler state machine, combo dispatch, and scan loop.
// Depends on: all prior headers, forward declarations above.
#include "buttons.h"

// Accent pattern bitmask — single source of truth for all 15 accent modes (OFF + 14 patterns).
// Bit 15 = step 0, bit 0 = step 15.  Used by triggerD3() and LED preview.
static inline uint16_t accentMaskFromMode(uint8_t mode) {
  switch (mode) {
    case ACCENT_PICKUP:    return 0b0000000000000010;  // step 14 only
    case ACCENT_HALF:      return 0b1000000010000000;  // steps 0, 8
    case ACCENT_QUARTER:   return 0b1000100010001000;  // steps 0, 4, 8, 12
    case ACCENT_EIGHTH_DOWN:   return 0b1010101010101010;  // even steps (downbeat eighths)
    case ACCENT_EIGHTH_UP:     return 0b0101010101010101;  // odd steps (upbeat eighths)
    case ACCENT_BOSSA:         return 0b1001001000100100;  // steps 0, 3, 6, 10, 13
    case ACCENT_OFFBEAT:       return 0b0010001000100010;  // offbeat quarter (steps 2, 6, 10, 14)
    case ACCENT_CLAVE:         return 0b1001001000101000;  // steps 0, 3, 6, 10, 12
    case ACCENT_THREE_TWO:     return 0b1001001010010010;  // steps 0, 3, 6, 8, 11, 14
    case ACCENT_PAIRS:         return 0b0011001100110011;  // pairs (steps 2-3, 6-7, 10-11, 14-15)
    case ACCENT_TRIPLET:       return 0b0010010010010010;  // 3-step grouping (steps 2, 5, 8, 11, 14)
    case ACCENT_DOTTED_EIGHTH: return 0b1001001001001001;  // dotted eighth (steps 0, 3, 6, 9, 12, 15)
    case ACCENT_BACK_HALF:     return 0b0000111100001111;  // back halves (steps 4-7, 12-15)
    case ACCENT_CASCADE:       return 0b1010010010100101;  // steps 0, 2, 5, 8, 10, 13, 15
    default: return 0;
  }
}

// --- Timers and Interrupts ---

void sysTickISR() {
  uint32_t now = sysTickMs + 1;
  sysTickMs = now;

  // Aligned 32-bit reads are atomic on ARM Cortex-M7
  if ((uint32_t)(now - lastFrameDrawTick) > OLED_WATCHDOG_TIMEOUT_MS) {
    requestOledReinit = true;
  }
}

// --- Audio Helpers ---

void updateDrumDelayGains() {
  // Decouple delay sends from the drum output levels.
  // This keeps delay tails and throws consistent even if a drum is turned down or muted.

  float s1 = d1DelaySend * 0.6f;   // D1 tapped post-amp — scale down to match D2 level
  float s2 = d2DelaySend;          // D2 tapped at snareClapMixer — reference level
  float s3 = d3DelaySend * 1.75f;  // D3 tapped post-filter (quieter than D2) — 1.75× compensates for filter attenuation

  // Keep the combined delay input from getting too hot.
  // (Prevents clipping when multiple sends are high at once.)
  const float SEND_SUM_TARGET = 0.90f;
  float sum = s1 + s2 + s3;
  if (sum > SEND_SUM_TARGET) {
    float scaleFactor = SEND_SUM_TARGET / sum;
    s1 *= scaleFactor;
    s2 *= scaleFactor;
    s3 *= scaleFactor;
  }

  AudioNoInterrupts();
  delaySendMixer.gain(0, s1);
  delaySendMixer.gain(1, s2);
  delaySendMixer.gain(2, s3);
  AudioInterrupts();
}

void applyMasterGain() {
  AudioNoInterrupts();
  masterAmp.gain(masterNominalGain);
  AudioInterrupts();
}

// Recompute cached D1 hold time (scales with decay).
// Call on choke or decay change.
static inline void updateD1HoldCache() {
  d1CachedHoldMs = d1EffectiveDecay * 0.75f;
}

// choke application on all relevant decays

void applyD1Decay() {
  float decay = d1DecayBase + chokeOffsetMs;
  if (decay < 17.0f) decay = 17.0f;
  d1EffectiveDecay = decay;
  updateD1HoldCache();
  AudioNoInterrupts();
  d1AmpEnv.hold(d1CachedHoldMs);
  d1AmpEnv.decay(d1EffectiveDecay);
  AudioInterrupts();
}

void applyD2Decay() {
  // D2 main decay (choke applied, clamped to 15–1000ms)
  float base2 = d2DecayBase + chokeOffsetMs;
  if (base2 < 15.0f) base2 = 15.0f;
  if (base2 > 1000.0f) base2 = 1000.0f;
  AudioNoInterrupts();
  d2AmpEnv.hold(base2 * 0.5f);
  d2AmpEnv.decay(base2);
  d2Body.length(base2 * 0.25f);
  AudioInterrupts();

  // D2 clap family — use knob position directly for clap curves
  float d2Norm = d2DecayNorm;
  // Flat 93ms below 50%, then accelerating curve → 130ms at 75%, 225ms at 100%
  float clapDecayBase;
  if (d2Norm <= 0.5f) {
    clapDecayBase = 93.0f;
  } else {
    float t = (d2Norm - 0.5f) * 2.0f;  // 0→1 over upper half
    clapDecayBase = 93.0f + 16.0f * t + 116.0f * t * t;
  }
  d2ClapEffectiveDecay = clapDecayBase + chokeOffsetMs;
  if (d2ClapEffectiveDecay < 10.0f) d2ClapEffectiveDecay = 10.0f;

  // Per-burst envelopes: linear 93→111ms over 0–65%, then accelerating to match clap tail
  float burstBase;
  if (d2Norm <= 0.65f) {
    burstBase = 93.0f + d2Norm * 27.0f;       // 93ms at min, ~111ms at 65%
  } else {
    float t = (d2Norm - 0.65f) / 0.35f;       // 0→1 over upper 35%
    burstBase = 111.0f + t * 114.0f;           // 111ms at 65%, 225ms at 100%
  }
  float burstDecay1 = burstBase + chokeOffsetMs * 0.3f;
  float burstDecay2 = (burstBase + 2.0f) + chokeOffsetMs * 0.3f;
  // Clamp burst decay to 80–225ms: floor prevents inaudible tails at full negative choke,
  // ceiling matches the clap master envelope maximum.
  if (burstDecay1 < 80.0f) burstDecay1 = 80.0f;
  if (burstDecay1 > 225.0f) burstDecay1 = 225.0f;
  if (burstDecay2 < 80.0f) burstDecay2 = 80.0f;
  if (burstDecay2 > 225.0f) burstDecay2 = 225.0f;

  AudioNoInterrupts();
  clapAmpEnv1.decay(burstDecay1);
  clapAmpEnv2.decay(burstDecay2);
  clapMasterEnv.decay(d2ClapEffectiveDecay);
  AudioInterrupts();
}

void applyD3Decay() {
  d3EffectiveDecay = computeD3Decay();
  AudioNoInterrupts();
  d3FmAmpEnv.decay(d3EffectiveDecay);
  d3606AmpEnv.decay(d3EffectiveDecay);
  d3Perc.length(d3EffectiveDecay);
  AudioInterrupts();
}

void applyChokeToDecays() {
  applyD1Decay();
  applyD2Decay();
  applyD3Decay();
}

void setup() {
  delay(200);

  // --- OLED display initialization ---

  // Args: (i2cAddr=0 unused for SPI, reset=true to hardware-reset the display)
  bool displayOk = display.begin(0, true);
  if (displayOk) {
    display.clearDisplay();

    // --- Factory reset: hold MEM on power-up for 5 seconds ---

    otherButtonsMux.channel(7);
    delayMicroseconds(10);
    if (!otherButtonsMux.read()) {  // MEM held (active-low)
      display.setTextColor(1);
      display.setTextWrap(false);
      display.setFont(NULL);
      display.setTextSize(2);
      display.setCursor(34, 0);
      display.print("CLEAR");
      display.setCursor(28, 20);
      display.print("EEPROM");
      display.display();  // blocking push OK — setup() runs before audio/ISR init

      // All display.display() calls in this factory-reset block are blocking
      // pushes — safe because setup() runs before audio/ISR init.
      bool held = true;
      for (int s = 5; s > 0 && held; s--) {
        display.fillRect(0, 48, 128, 16, 0);
        display.setCursor(58, 48);
        display.print(s);
        display.display();

        for (int i = 0; i < 10 && held; i++) {
          delay(100);
          otherButtonsMux.channel(7);
          delayMicroseconds(10);
          if (otherButtonsMux.read()) held = false;
        }
      }

      if (held) {
        display.clearDisplay();
        display.setCursor(28, 8);
        display.print("EEPROM");
        display.setCursor(22, 28);
        display.print("CLEARED");
        display.display();
        for (int i = 0; i < (int)EEPROM.length(); i++) {
          EEPROM.update(i, 0xFF);
        }
        delay(2000);
      }

      display.clearDisplay();
      display.display();
    }

    // Animated splash screen
    splashAnimation();

    // Precompute MONOBASS dither masks (renders text off-screen, reads back)
    precomputeMonoMasks();
  }

  // --- Audio system initialization ---

  AudioMemory(1200);  // Delay at 1400ms needs ~483 blocks; 93 audio objects need the rest (RAM2 only, no CPU cost)
  sysTickTimer.begin(sysTickISR, 1000);
  audioInit();
  d1AmpEnv.attack(D1_ATTACK_MS);  // permanent value — not set in audioInit (D1_ATTACK_MS not yet visible there)
  scopeQueue.begin();

  // --- UI state initialization ---

  // Clear overlay and parameter strings at boot (now sysTickMs is valid)
  activeRail = RAIL_NONE;
  displayParameter1[0] = 0;
  displayParameter2[0] = 0;

  noInterrupts();
  parameterOverlayStartTick = sysTickMs - PARAMETER_OVERLAY_DURATION_MS - 1;
  interrupts();

  // Load saved PPQN from EEPROM (defaults to 2 if nothing saved)
  loadPpqnFromEEPROM();

  // --- Hardware initialization ---

  // Initialize shift register and LEDs
  ledShiftReg.setAllLow();
  updateLEDs();

  // Configure ADC hardware averaging — cleaner signal before it reaches software
  analogReadAveraging(KNOB_HW_AVG);

  // Initialize knob smoothing filters
  for (int i = 0; i < knobCount; i++) {
    analog[i] = new ResponsiveAnalogRead(0, true);
    if (!analog[i]) {
      Serial.println("[ERROR] Failed to allocate ResponsiveAnalogRead");
      while (true) { /* halt */ }
    }
    analog[i]->setActivityThreshold(KNOB_ACTIVITY_THRESH);
    analog[i]->setSnapMultiplier(KNOB_SNAP_MULTI);
  }

  // --- External clock pin ---

  pinMode(EXT_CLK_PIN, INPUT_PULLDOWN);
  attachInterrupt(digitalPinToInterrupt(EXT_CLK_PIN), externalClockISR, RISING);

  // Explicitly set GPIO ISR priority to match IntervalTimer default (128).
  // All three ISR sources (externalClockISR on GPIO, stepISR and
  // subdivTimerCallback on PIT) must run at the same NVIC priority so they
  // cannot preempt each other. This makes the non-atomic read-modify-write
  // on pendingStepCount and currentStep safe (see concurrency contract in
  // ext_sync.h). attachInterrupt() does not set priority — it inherits
  // the startup default (128), but we pin it here explicitly so a future
  // Teensy core change can't silently break the assumption.
  NVIC_SET_PRIORITY(IRQ_GPIO6789, 128);

  // --- Load state and start sequencer ---

  initKnobsFromHardware();
  loadStateFromEEPROM(activeSaveSlot);
  if (loadMonoBassStatusFromEEPROM()) enterMonoBassMode();
  rearmStepTimer();
  applyMasterGain();

  // Seed the OLED watchdog so it doesn't fire on the first loop() iteration.
  // sysTickTimer just started — without this, the stale lastFrameDrawTick=0
  // could exceed OLED_WATCHDOG_TIMEOUT_MS before the first updateDisplay().
  noInterrupts();
  lastFrameDrawTick = sysTickMs;
  interrupts();

}

void loop() {
  // --- Accent preview timeout ---

  // Single stable timebase for top-of-loop checks
  uint32_t loopNowTick;
  noInterrupts();
  loopNowTick = sysTickMs;  // sysTickMs is ISR-written, needs guard
  interrupts();

  // MONOBASS envelope filter decay — runs every 5ms when active
  if (monoBass.active) {
    static uint32_t lastEnvFiltTick = 0;
    if ((uint32_t)(loopNowTick - lastEnvFiltTick) >= 5) {
      lastEnvFiltTick = loopNowTick;
      updateMonoBassEnvFilter(loopNowTick);
    }
  }

  // D1 chroma envelope filter decay — runs every 5ms when d1ChromaMode active.
  // Guard: skip during MONOBASS — MONOBASS owns d1LowPass via its own env filter.
  if (d1ChromaMode && !monoBass.active) {
    static uint32_t lastChromaEnvFiltTick = 0;
    if ((uint32_t)(loopNowTick - lastChromaEnvFiltTick) >= 5) {
      lastChromaEnvFiltTick = loopNowTick;
      updateD1ChromaEnvFilter(loopNowTick);
    }
  }

  // Expire accent preview and restore normal LEDs
  if (accentPreview.active) {
    if ((uint32_t)(loopNowTick - accentPreview.startTick) >= ACCENT_PREVIEW_DURATION_MS) {
      accentPreview.active = false;  // Main-loop only — no guard needed
      updateLEDs();
    }
  }

  // Step LED flash animation (save/load/slot-select feedback)
  updateFlashLed();

  // PPQN mode timeout — auto-exit without saving after 5s inactivity
  if (ppqnModeActive) {
    if ((uint32_t)(loopNowTick - ppqnModeLastActivityTick) >= PPQN_MODE_TIMEOUT_MS) {
      ppqnModeActive = false;
      // No save — just exit silently. Normal display resumes automatically.
    }
  }

  // --- OLED watchdog recovery ---

  // Atomic check-and-clear prevents losing a flag set between the
  // if-check and the clear (ISR could fire in between otherwise)
  {
    bool needsReinit;
    noInterrupts();
    needsReinit = requestOledReinit;
    requestOledReinit = false;
    interrupts();

    if (needsReinit) {
      display.begin(0, true);  // i2cAddr=0 unused for SPI, reset=true
      display.clearDisplay();
      playSequence();  // drain any pending steps before push
      uint32_t t;
      noInterrupts();
      t = sysTickMs;
      interrupts();
      oledStartPushAndStamp(t);
    }
  }

  // --- Chunked OLED page push (non-blocking) ---
  // Push one SH1106 page per loop iteration (~2ms). USB audio interrupts
  // can fire between pages, preventing buffer underruns that cause clicks.
  oledPushOnePage();

  // --- External clock: lock-in handoff + timeout detection ---

  checkExtClockLockIn();
  checkExtClockTimeout();

  // --- Sequencer step processing (before input to minimize latency) ---
  // playSequence() is called at 4 points in loop() (here, post-input,
  // mid-display-draw, and post-OLED) to minimize latency between an ISR
  // queuing a step and the main loop firing audio. Each call is a fast
  // no-op when pendingStepCount == 0.

  if (sequencePlaying) {
    playSequence();
  }
  // Gain is already applied by knob handlers — no per-loop update needed when stopped

  updateExtBpmDisplay();

  // --- User input polling ---

  updateOtherButtons();
  updateKnobs();
  updateStepButtons();

  // --- Post-input step processing ---
  // Fire any step queued by the PLAY button or ISR immediately,
  // before the OLED framebuffer build and chunked push add latency.
  if (sequencePlaying) {
    playSequence();
  }

  // --- Oscilloscope data acquisition ---

  updateScopeData();

  // --- Throttled OLED refresh (~24 FPS) ---

  uint32_t tickCopy, lastDrawCopy;

  noInterrupts();
  tickCopy = sysTickMs;
  lastDrawCopy = lastFrameDrawTick;
  interrupts();

  uint32_t frameInterval = (transportState == RUN_EXT)
                           ? OLED_FRAME_INTERVAL_EXT_MS
                           : OLED_FRAME_INTERVAL_MS;
  if ((uint32_t)(tickCopy - lastDrawCopy) >= frameInterval) {
    // Skip entire OLED frame (framebuffer build + push) if a subdivision step
    // is due within OLED_SUBDIV_GUARD_US. The build itself takes 2-4ms; the
    // 5ms guard adds margin so the build doesn't overlap the step trigger.
    // (A second guard, OLED_GUARD_US, protects the push-start inside
    // isSafeToPushOled() for cases where the step becomes imminent after
    // the build completes but before the push begins.)
    bool skipForSubdiv = false;
    if (transportState == RUN_EXT && subdivTimerDueUs != 0) {
      uint32_t nowUs = micros();
      int32_t untilDue = (int32_t)(subdivTimerDueUs - nowUs);
      if (untilDue > 0 && (uint32_t)untilDue < OLED_SUBDIV_GUARD_US) {
        skipForSubdiv = true;
      }
    }
    // Skip OLED push when a MONOBASS key event just fired — the SPI transfer
    // would add latency to the next key scan.
    bool skipForMonoBass = monoBassKeyEvent;
    monoBassKeyEvent = false;
    // Don't rebuild framebuffer while a chunked push is still in progress
    if (!skipForSubdiv && !skipForMonoBass && !oledPushInProgress()) {
      updateDisplay();
    }
  }

  // --- Post-display step catch-up ---
  // Run step processing after display work so any steps queued during the
  // page push or framebuffer build fire promptly.
  if (sequencePlaying) {
    playSequence();
  }
}

// Transport state machine — pure state + timer management, no interrupt guards.
//
// transportState is volatile uint8_t (ARM atomic STRB) — the assignment is
// inherently race-safe without explicit masking. This function intentionally
// does NOT call noInterrupts()/interrupts() so it can safely be called from
// within a caller's existing critical section. ARM noInterrupts/interrupts are
// non-nestable: an inner interrupts() call re-enables PRIMASK regardless of
// any outer guard, breaking the caller's atomicity.
//
// Callers that bundle setTransport() with other ISR-shared writes must wrap
// the entire block in noInterrupts()/interrupts():
//   handlePlayStop()    — also writes sequencePlaying, armed, armPulseCountdown
//   enterMonoBassMode() — same (monobass.h)
//   btnMemoryHold()     — also writes sequencePlaying
//
// Callers that change only transportState need no guard (uint8_t is atomic):
//   checkExtClockLockIn(), checkExtClockTimeout()
void setTransport(TransportState s) {
  if (transportState == s) return;

  transportState = s;
  if (s != RUN_EXT) {
    extStepAcc = 0;
    subdivTimer.end();           // safe inside noInterrupts — staleness guard in
    subdivStepsRemaining = 0;    // subdivTimerCallback covers NVIC-pending edge case
    subdivTimerDueUs = 0;
  }

  switch (s) {
    case RUN_INT:
      rearmStepTimer();     // ends + restarts internal clock timer
      break;
    case RUN_EXT:
      stepTimer.end();      // stop internal clock — pulses drive steps now
      // extStepAcc is preserved: the ISR may have already written a valid
      // accumulator value on the locking pulse that triggered this transition.
      break;
    case STOPPED:
    default:
      stepTimer.end();      // stop all timers
      break;
  }
}

// --- Sequencing and Triggers ---

void playSequence() {
  // Snapshot pendingStepCount and currentStep atomically.
  // ISR advances currentStep and increments pendingStepCount together;
  // reading both inside noInterrupts ensures a consistent snapshot.
  uint8_t toDo;
  uint8_t targetStep;
  noInterrupts();
  toDo = pendingStepCount;
  pendingStepCount = 0;
  targetStep = currentStep;
  interrupts();

  if (toDo == 0) return;

  // With 2 accumulated steps (common at ppqn=2 ext sync, rare on internal
  // clock at high BPM if the main loop stalls briefly), fire both to
  // preserve rhythmic density.  ISR already advanced currentStep twice,
  // so targetStep is the second step; firstStep = targetStep-1.
  // For 3+ steps, skip ahead — a missing step is less noticeable than
  // an off-beat one.
  if (toDo == 2) {
    uint8_t firstStep = (targetStep - 1 + numSteps) % numSteps;
    playSequenceCore(firstStep);   // fire first step
    playSequenceCore(targetStep);  // fire second step
  } else {
    // Single step or skip-ahead — fire only the latest step.
    // ISR already advanced currentStep past any skipped steps.
    playSequenceCore(targetStep);
  }

  updateLEDs();
}

// Trigger active drums for a specific step.
// Step advancement happens in ISR (stepISR / externalClockISR / subdivTimerCallback),
// so this function only fires audio — no step counter mutation.
// Called from main loop context via playSequence().
void playSequenceCore(uint8_t step) {
  // MONOBASS mode: entire sequencer suppressed — D1 is live keyboard only
  if (monoBass.active) return;

  if (d1Sequence[step]) {
    if (d1ChromaMode) {
      d1BaseFreq = d1ChromaFreq(d1ChromaNote[step]);
      applyD1Freq();
    }
    triggerD1();
  }
  if (d2Sequence[step]) {
    if (d2ChromaMode) {
      applyD2ChromaFreq(d2ChromaNote[step]);
    }
    triggerD2();
  }
  if (d3Sequence[step]) {
    if (d3ChromaMode) {
      applyD3ChromaFreq(d3ChromaNote[step]);
    }
    triggerD3(step);
  }
}

// Decay d1LowPass from its trigger peak back toward d1ChromaEnvFiltBaseHz.
void triggerD1() {
  // Retrigger guard — uint32_t reads/writes are atomic on ARM Cortex-M7.
  // Called from main loop context via playSequenceCore().
  uint32_t now = micros();
  bool skipNoteOff = !monoBass.active && (now - lastD1TriggerUs) < MIN_RETRIGGER_US;
  lastD1TriggerUs = now;

  AudioNoInterrupts();
  if (monoBass.active) {
    // Gate-style: retrigger amp envelope + snap, no pitch sweep
    d1AmpEnv.noteOff();
    d1AmpEnv.noteOn();
    d1Snap.noteOn();
  } else {
    d1AmpEnv.hold(d1CachedHoldMs);
    d1AmpEnv.decay(d1EffectiveDecay);
    if (!skipNoteOff) {
      d1AmpEnv.noteOff();
      d1PitchEnv.noteOff();
    }
    d1AmpEnv.noteOn();
    d1PitchEnv.noteOn();
    d1Snap.noteOn();
    if (d1ChromaMode && d1ChromaEnvFiltDepth > 0.01f) {
      d1ChromaEnvFiltTrigger = sysTickMs;
      float peak = d1ChromaEnvFiltBaseHz
                 + d1ChromaEnvFiltDepth * (kEnvFiltCeiling - d1ChromaEnvFiltBaseHz);
      if (peak > kEnvFiltCeiling) peak = kEnvFiltCeiling;
      d1LowPass.frequency(peak);
      d1LowPass.resonance(1.5f + 2.5f * d1ChromaEnvFiltDepth);
    }
  }
  AudioInterrupts();
}

// Trigger D2 (snare/clap) — called from main loop via playSequenceCore().
// Handles retrigger guard and envelope noteOff/noteOn.
// Decay values are already set by applyChokeToDecays() when choke or decay knob changes.
void triggerD2() {
  uint32_t now = micros();
  bool skipNoteOff = (now - lastD2TriggerUs) < MIN_RETRIGGER_US;
  lastD2TriggerUs = now;

  AudioNoInterrupts();
  if (!skipNoteOff) {
    d2AmpEnv.noteOff();
    clapAmpEnv1.noteOff();
    clapAmpEnv2.noteOff();
    clapMasterEnv.noteOff();
    d2NoiseEnv.noteOff();
  }
  d2AmpEnv.noteOn();
  clapAmpEnv1.noteOn();
  clapAmpEnv2.noteOn();
  clapMasterEnv.noteOn();
  d2Body.noteOn();
  d2ClickTransient.noteOn();
  d2NoiseEnv.noteOn();
  AudioInterrupts();
}

// Trigger D3 (hi-hat) — called from main loop via playSequenceCore().
// Applies accent pattern if active, handles retrigger guard.
void triggerD3(uint8_t step) {
  uint32_t now = micros();
  bool skipNoteOff = (now - lastD3TriggerUs) < MIN_RETRIGGER_US;
  lastD3TriggerUs = now;

  // Use cached decay and accent mask (updated by applyChokeToDecays / accent knob)
  float applyDecay = d3EffectiveDecay;

  // step is always 0–15 (uint8_t from currentStep % numSteps)
  if (d3AccentMask && ((d3AccentMask >> ((numSteps - 1) - step)) & 1)) {
    applyDecay *= D3_ACCENT_FACTOR;
  }

  AudioNoInterrupts();
  d3FmAmpEnv.decay(applyDecay);
  d3606AmpEnv.decay(applyDecay);
  d3Perc.length(applyDecay);
  if (!skipNoteOff) {
    d3FmAmpEnv.noteOff();
    d3606AmpEnv.noteOff();
  }
  d3FmAmpEnv.noteOn();
  d3606AmpEnv.noteOn();
  d3Perc.noteOn();
  AudioInterrupts();
}

// --- Buttons and LEDs ---

// PLAY/STOP handler — called on button 6 press from updateOtherButtons().
void handlePlayStop() {
  if (!sequencePlaying) {
    // Check for recent external sync pulses — even 1 is enough for drop-in.
    // Lock-in auto-detect requires 3 pulses (two similar intervals),
    // which is too strict for explicit drop-in. Here we only need to know
    // "has the Volca been sending clock recently?"
    bool hasRecentPulse = false;
    noInterrupts();
    uint32_t lastP = lastPulseMicros;
    interrupts();
    if (lastP != 0 && (micros() - lastP) < EXT_TIMEOUT_US) {
      hasRecentPulse = true;
    }

    // PLAY = ARM. No step fires here. The next external pulse (or
    // internal tick for RUN_INT) fires step 0.
    // Snapshot sysTickMs before the critical section — avoids reading
    // the volatile inside noInterrupts() where it can't update anyway.
    uint32_t nowTick = sysTickMs;
    // Wide critical section — subdivTimer.end() must be inside to prevent
    // a pending callback from firing between end() and state zeroing.
    noInterrupts();
    subdivTimer.end();
    pendingStepCount = 0;
    extStepAcc = 0;
    subdivStepsRemaining = 0;
    subdivTimerDueUs = 0;

    if (hasRecentPulse) {
      // External sync — count-in for one full cycle, then fire step 0.
      armed = true;
      static_assert((uint32_t)16 * 96 / 4 <= UINT16_MAX, "armPulseCountdown overflow");
      armPulseCountdown = (uint32_t)numSteps * ppqn / STEPS_PER_BEAT;

      // Grace window: snap to nearest pulse.
      // If the user pressed PLAY just after a pulse (within the first
      // half of a pulse interval), credit that pulse to the count-in.
      // Guard: keep at least 1 so the ISR fires step 0 on a real pulse.
      uint32_t ema = extIntervalEMA;       // safe: interrupts already off
      uint32_t elapsed = micros() - lastPulseMicros;
      if (ema > 0 && elapsed < (ema / 2) && armPulseCountdown > 1) {
        armPulseCountdown--;
      }

      sequencePlaying = true;
      setTransport(RUN_EXT);
    } else {
      // No external clock — start on internal timer immediately.
      // currentStep = numSteps-1 so the first internal tick advances to step 0.
      armed = false;
      armPulseCountdown = 0;
      currentStep = numSteps - 1;
      sequencePlaying = true;
      setTransport(RUN_INT);
    }
    displayBlockedUntilTick = nowTick + 500;  // suppress OLED push during drop-in
    interrupts();
  } else {
    // STOP — also aborts armed count-in if active.
    // Preserves pulse timing state so ext clock is detected
    // immediately on the next PLAY press.
    noInterrupts();
    sequencePlaying = false;
    setTransport(STOPPED);
    armed = false;
    armPulseCountdown = 0;
    pendingStepCount = 0;
    wantSwitchToExt = false;
    interrupts();
    applyMasterGain();
  }
}

void selectTrack(Track t) {
  activeTrack = t;
  updateLEDs();
}

void updateLEDs() {
  // Main-loop only — no ISR access to accentPreview*, no guards needed

  // X-combo overlay — LEDs set by btnComboPress(), don't overwrite.
  // monoAnimPhase check: allow LED updates during MONOBASS text animation
  // so the entering/exiting sweep doesn't freeze the step LEDs.
  if (comboMod.held && !comboMod.comboFired
      && !ppqnModeActive && monoAnimPhase == MONO_ANIM_NONE) {
    return;
  }

  // MONOBASS mode — first 12 LEDs lit as usable-key indicators (12 notes/octave)
  if (monoBass.active) {
    for (int i = 0; i < numSteps; i++) {
      ledShiftReg.setNoUpdate(i, i < 12);
    }
    ledShiftReg.updateRegisters();
    return;
  }

  bool preview = accentPreview.active;
  uint16_t mask = accentPreview.mask;

  // Accent preview mode (temporary display)
  if (preview) {
    for (int i = 0; i < numSteps; i++) {
      bool on = (mask >> ((numSteps - 1) - i)) & 1;
      ledShiftReg.setNoUpdate(i, on);
    }
    ledShiftReg.updateRegisters();
    return;
  }

  // Normal pattern display with optional current step indicator
  uint8_t* seq = sequenceForTrack(activeTrack);

  // Snapshot play state — both volatile (ISR-written)
  uint8_t currentStepSnap;
  bool playingSnap;
  noInterrupts();
  currentStepSnap = currentStep;
  playingSnap = sequencePlaying;
  interrupts();

  for (int i = 0; i < numSteps; i++) {
    bool ledState = seq[i];

    // Force current step ON when playing (creates moving bright spot)
    if (playingSnap && i == currentStepSnap) {
      ledState = true;
    }

    ledShiftReg.setNoUpdate(i, ledState);
  }
  ledShiftReg.updateRegisters();
}

// Step LED flash — non-blocking double-blink on a specific step LED.
// Used for save/load/slot-select visual feedback.
static int8_t flashLedIndex = -1;
static uint8_t flashLedCount = 0;
static uint32_t flashLedTick = 0;
static bool flashLedOn = false;
static constexpr uint32_t FLASH_LED_ON_MS  = 80;
static constexpr uint32_t FLASH_LED_OFF_MS = 80;

// flashStepLed/updateFlashLed: sysTickMs reads are single aligned 32-bit
// loads (atomic LDR on Cortex-M7).  flashLed* variables are main-loop only.
static void flashStepLed(uint8_t stepIndex, uint8_t count) {
  flashLedIndex = stepIndex;
  flashLedCount = count;
  flashLedTick = sysTickMs;
  flashLedOn = true;
  ledShiftReg.set(stepIndex, true);
}

static void updateFlashLed() {
  if (flashLedIndex < 0) return;
  uint32_t now = sysTickMs;  // snapshot once — ISR may update between reads
  uint32_t elapsed = now - flashLedTick;
  if (flashLedOn && elapsed >= FLASH_LED_ON_MS) {
    flashLedOn = false;
    flashLedTick = now;
    ledShiftReg.set(flashLedIndex, false);
  } else if (!flashLedOn && elapsed >= FLASH_LED_OFF_MS) {
    flashLedCount--;
    if (flashLedCount == 0) {
      flashLedIndex = -1;
      updateLEDs();
      return;
    }
    flashLedOn = true;
    flashLedTick = now;
    ledShiftReg.set(flashLedIndex, true);
  }
}

// Returns the active chroma held-step pointer for the current track, or nullptr
static inline int8_t* activeChromaHeldStep() {
  if (d1ChromaMode && activeTrack == TRACK_D1) return &d1ChromaHeldStep;
  if (d2ChromaMode && activeTrack == TRACK_D2) return &d2ChromaHeldStep;
  if (d3ChromaMode && activeTrack == TRACK_D3) return &d3ChromaHeldStep;
  return nullptr;
}

// Returns the per-step MIDI note array for the active chroma channel, or nullptr
static inline uint8_t* activeChromaNotes() {
  if (d1ChromaMode && activeTrack == TRACK_D1) return d1ChromaNote;
  if (d2ChromaMode && activeTrack == TRACK_D2) return d2ChromaNote;
  if (d3ChromaMode && activeTrack == TRACK_D3) return d3ChromaNote;
  return nullptr;
}

void updateStepButtons() {
  static uint32_t lastDebounceTick[stepButtonCount] = { 0 };
  static bool btnState[stepButtonCount] = { false };
  static bool btnLastState[stepButtonCount] = { false };
  static uint32_t stepPressTick[stepButtonCount] = { 0 };

  uint8_t* seq = sequenceForTrack(activeTrack);

  // single stable timebase for this whole scan
  uint32_t nowTick;
  noInterrupts();
  nowTick = sysTickMs;
  interrupts();

  for (int i = 0; i < stepButtonCount; i++) {
    stepButtonsMux.channel(i);
    delayMicroseconds(5);
    bool rawPressed = !stepButtonsMux.read();  // no arg — use channel already set above

    if (rawPressed != btnLastState[i]) {
      lastDebounceTick[i] = nowTick;
    }

    uint16_t debounceMs = monoBass.active ? MONOBASS_DEBOUNCE_MS : STEP_DEBOUNCE_MS;
    if ((uint32_t)(nowTick - lastDebounceTick[i]) > debounceMs && (rawPressed != btnState[i])) {

      btnState[i] = rawPressed;

      // MONOBASS mode — buttons trigger D1 directly, skip all sequence editing
      if (handleMonoBassButton(i, btnState[i])) {
        btnLastState[i] = rawPressed;
        continue;
      }

      // Combo+step: slot select (0-9), shuffle (15), or no-op (10-14)
      if (comboMod.held && btnState[i]) {
        cancelMonoAnim();

        if (i >= 10 && i <= 14) {
          // Steps 10-14: reserved, no action, no LED blink
          btnLastState[i] = rawPressed;
          continue;
        }

        if (monoBass.active) {
          showMonoBassDisabled(nowTick);
          btnLastState[i] = rawPressed;
          continue;
        }

        if (i == 15) {
          // Step 15: cycle shuffle mode (OFF → 1 → … → 7 → OFF).
          // Keep comboFired=false so the overlay stays visible and the user can
          // keep holding X and pressing step 15 to cycle further.
          // Suppress MONOBASS entry (monoFired+monoAnimStarted) without clearing the overlay.
          comboMod.monoAnimStarted = true;
          comboMod.monoFired = true;
          cycleShuffle(nowTick);
        } else if (i <= 9) {
          // Steps 0-9: select memory slot (pending).
          // Does NOT load — user presses LOAD to commit.
          comboMod.comboFired = true;
          activeSaveSlot = i;
          slotPending = true;
          snprintf(displayParameter1, sizeof(displayParameter1), "SLOT %d", i + 1);
          snprintf(displayParameter2, sizeof(displayParameter2), "SELECTED");
          parameterOverlayStartTick = nowTick;
          activeRail = RAIL_NONE;
          flashStepLed(i, 2);
        }

        btnLastState[i] = rawPressed;
        continue;
      }

      int8_t* heldStep = activeChromaHeldStep();

      if (btnState[i]) {
        // Press down
        if (heldStep) {
          // Chroma mode — defer toggle to release (to distinguish from hold)
          stepPressTick[i] = nowTick;
        } else {
          // Normal mode — toggle step immediately
          seq[i] ^= 1;
          ledShiftReg.set(i, seq[i]);
          patternDirty = true;
        }
      } else {
        // Release
        if (heldStep) {
          if (*heldStep == i) {
            // Was in note-select — just clear, no toggle
            *heldStep = -1;
          } else {
            // Short press — toggle step
            seq[i] ^= 1;
            ledShiftReg.set(i, seq[i]);
            patternDirty = true;
          }
        }
      }
    }

    // Chroma note-select: after holding a step button for 300ms, enter note-select
    if (!monoBass.active) {
      int8_t* heldStep = activeChromaHeldStep();
      if (heldStep && btnState[i]) {
        if (*heldStep == i) {
          // Already in note-select — keep overlay alive
          uint8_t* notes = activeChromaNotes();
          char noteName[8];
          formatChromaNote(notes[i], noteName);
          snprintf(displayParameter1, sizeof(displayParameter1), "STEP %d", i + 1);
          snprintf(displayParameter2, sizeof(displayParameter2), "%s", noteName);
          parameterOverlayStartTick = nowTick;
        } else if (*heldStep < 0 && stepPressTick[i] != 0
                   && (uint32_t)(nowTick - stepPressTick[i]) >= CHROMA_STEP_HOLD_MS) {
          *heldStep = i;
        }
      }
    }

    btnLastState[i] = rawPressed;
  }
}

int readKnobRaw(uint8_t idx) {
  admux::Mux& mux = (idx < 16) ? knobMux1 : knobMux2;
  mux.channel(idx < 16 ? idx : idx - 16);
  delayMicroseconds(KNOB_MUX_SETTLE_US);
  int sum = 0;
  for (int i = 0; i < KNOB_OVERSAMPLE; i++) {
    sum += mux.read();
  }
  int raw = sum / KNOB_OVERSAMPLE;
  // Clamp ADC edges: pots rarely hit true 0/1023 — map the reliable
  // range to the full 0-1023 so both extremes are always reachable.
  raw = constrain(raw, 3, 1020);
  return map(raw, 3, 1020, 0, 1023);
}

// --- Shared curve helpers (used by both display and engine) ---

// D1 Decay curve: piecewise 50–70 ms (low range) then 70–1000 ms (high range)
static inline float d1DecayCurve(int knobValue) {
  float norm = normalizeKnob(knobValue);
  if (norm <= 0.25f) {
    float blend = norm / 0.25f;
    return 50.0f + (70.0f - 50.0f) * blend;
  } else {
    float blend = (norm - 0.25f) / 0.75f;
    return 70.0f + (1000.0f - 70.0f) * blend;
  }
}

// D1 Pitch curve: piecewise 55–110 Hz (A1→A2) then 110–440 Hz (A2→A4)
static inline float d1PitchCurve(int knobValue) {
  float norm = normalizeKnob(knobValue);
  if (norm <= 0.33f) {
    float blend = norm / 0.33f;
    return 55.0f + (110.0f - 55.0f) * blend;   // A1(55) → A2(110)
  } else {
    float blend = (norm - 0.33f) / 0.67f;
    return 110.0f + (440.0f - 110.0f) * blend;  // A2(110) → A4(440)
  }
}

// D2 Decay curve: 75–93ms (0–50%), 93–225ms (51–75%), 225–500ms (75–100%)
static inline float d2DecayCurve(int knobValue) {
  float norm = normalizeKnob(knobValue);
  if (norm <= 0.5f) {
    float t = norm / 0.5f;             // 0..1 over bottom half
    return 75.0f + t * 18.0f;          // 75 -> 93ms
  } else if (norm <= 0.75f) {
    float t = (norm - 0.5f) / 0.25f;   // 0..1 over 50–75%
    return 93.0f + t * 132.0f;         // 93 -> 225ms
  } else {
    float t = (norm - 0.75f) / 0.25f;  // 0..1 over 75–100%
    return 225.0f + t * 275.0f;        // 225 -> 500ms
  }
}

// D3 Filter curve: 800–7500 Hz exponential (log-spaced for natural feel)
static inline float d3FilterCurve(int knobValue) {
  float norm = normalizeKnob(knobValue);
  return 1200.0f * expf(norm * 2.303f);  // ln(12000/1200) ≈ 2.303
}

// BPM curve: 60–400 (first 85%) then 900–999 (remaining 15%, hyperspeed), rounded to 0.5
// NOTE: The 400–900 gap is intentional — hyperspeed is a separate creative effect.
static inline float bpmFromKnob(int knobValue) {
  float norm = normalizeKnob(knobValue);
  float bpmValue;
  if (norm <= 0.85f) {
    // 0–85%: 60 → 400 BPM (normal range)
    float blend = norm / 0.85f;
    bpmValue = 60.0f + blend * (400.0f - 60.0f);
  } else {
    // 85–100%: 900 → 999 BPM (hyperspeed)
    float blend = (norm - 0.85f) / 0.15f;
    bpmValue = 900.0f + blend * (999.0f - 900.0f);
  }
  return floorf(bpmValue * 2.0f + 0.5f) * 0.5f;
}

// Accent mode from knob position — maps knob to one of 15 accent modes (OFF + 14 patterns).
// AccentMode enum values are sequential (0=OFF, 1=PICKUP ... 14=CASCADE).
static inline uint8_t accentModeFromKnob(int knobValue) {
  const int ACCENT_DEADBAND = 24;
  if (knobValue <= ACCENT_DEADBAND) return ACCENT_OFF;
  int zone = map(knobValue, ACCENT_DEADBAND + 1, 1023, 1, 14);
  return (uint8_t)constrain(zone, 1, (int)ACCENT_CASCADE);
}

// Delay ratio index from knob — finds the closest beat-synced ratio within delay limit
static inline int delayRatioFromKnob(int knobValue, float currentBpm) {
  float msPerBeat = 60000.0f / currentBpm;
  float maxRatio = 1400.0f / msPerBeat;

  int maxIdx = 0;
  for (int ratioIndex = 0; ratioIndex < NUM_RATIOS; ratioIndex++) {
    if (quantizeRatios[ratioIndex] <= maxRatio) {
      maxIdx = ratioIndex;
    } else {
      break;
    }
  }

  int ratioIdx = (int)(normalizeKnob(knobValue) * maxIdx + 0.5f);
  return constrain(ratioIdx, 0, maxIdx);
}

// Knob handler dispatch table — 32 display + 32 engine functions.
// Replaces the former 32-case switch blocks in updateParameterDisplay()
// and applyKnobToEngine(). See knob_handlers.h for per-knob functions.
#include "knob_handlers.h"

// Last-knob-wins: each call overwrites displayParameter1/2.  Stale overlay
// from a previously moved knob is harmless — it shows for ≤500 ms and is
// always replaced by the next knob touch.  RAIL_NONE is also set inside
// displayDisabledInMonoBass() so MONOBASS-disabled knobs clear the rail bar.
void updateParameterDisplay(uint8_t idx, int knobValue) {
  // sysTickMs is a single aligned 32-bit read (atomic LDR on ARM Cortex-M7).
  // parameterOverlayStartTick is main-loop only — no guard needed.
  parameterOverlayStartTick = sysTickMs;
  activeRail = RAIL_NONE;
  if (idx < 32) knobTable[idx].display(idx, knobValue);
}

void applyKnobToEngine(uint8_t idx, int knobValue) {
  if (idx < 32) knobTable[idx].engine(idx, knobValue);
}


// --- Initialization from Hardware ---

void initKnobsFromHardware() {
  // Read all knobs, settle filters, apply to engine, and store boot values.
  // Boot-lock prevents ADC drift from changing params until the user moves a knob.
  for (int idx = 0; idx < knobCount; idx++) {
    int rawValue = readKnobRaw(idx);

    // Update filter multiple times to settle it
    for (int i = 0; i < 4; i++) {
      analog[idx]->update(rawValue);
    }

    knobBootValue[idx] = rawValue;
    knobUnlocked[idx] = false;

    applyKnobToEngine(idx, rawValue);
  }

  // Re-sync delay time: knob 24 (delay) was processed before knob 27 (BPM),
  // so it computed against the default 120 BPM. Now that BPM is finalized,
  // recalculate the delay to match the actual physical BPM knob position.
  applyKnobToEngine(24, analog[24]->getValue());
}

// OPTIMIZATION: round-robin knob scanning — reads 8 knobs per loop iteration
// instead of all 32, reducing per-loop delayMicroseconds overhead by 4x
void updateKnobs() {
  static uint8_t knobScanGroup = 0;
  int start = knobScanGroup * 8;
  int end = start + 8;

  for (int idx = start; idx < end; idx++) {
    int rawValue = readKnobRaw(idx);
    analog[idx]->update(rawValue);

    if (analog[idx]->hasChanged()) {
      int knobValue = analog[idx]->getValue();

      // Boot-lock: ignore small ADC drift until the user intentionally moves
      // the knob past the unlock threshold from its power-on position.
      if (!knobUnlocked[idx]) {
        int diff = knobValue - knobBootValue[idx];
        if (diff < 0) diff = -diff;
        if (diff < KNOB_UNLOCK_THRESHOLD) continue;
        knobUnlocked[idx] = true;
      }

      updateParameterDisplay(idx, knobValue);
      applyKnobToEngine(idx, knobValue);
    }
  }

  knobScanGroup = (knobScanGroup + 1) & 3;  // 0,1,2,3 → cycle through 4 groups
}

// ============================================================================
// Non-blocking OLED page push
//
// The SH1106 framebuffer is 8 pages × 128 bytes = 1024 bytes.  Pushing it all
// at once via software SPI (bit-bang) blocks the CPU for 15-25 ms, which
// starves USB audio packet delivery and causes audible clicks.
//
// Instead, we push one page (~131 bytes ≈ 2 ms) per loop() iteration.  USB
// audio interrupts can fire between pages, eliminating the underrun window.
// ============================================================================

static int8_t oledPushPage = -1;  // -1 = idle, 0–7 = page being pushed next

static inline void oledSwSpiWrite(uint8_t data) {
  for (int8_t bit = 7; bit >= 0; bit--) {
    digitalWriteFast(OLED_MOSI, (data >> bit) & 1);
    digitalWriteFast(OLED_CLK, HIGH);
    digitalWriteFast(OLED_CLK, LOW);
  }
}

static inline void oledSwSpiCmd(uint8_t cmd) {
  digitalWriteFast(OLED_DC, LOW);
  oledSwSpiWrite(cmd);
  digitalWriteFast(OLED_DC, HIGH);
}

// Push one SH1106 page (128 data bytes + 3 command bytes ≈ 2 ms).
static void oledPushOnePage() {
  if (oledPushPage < 0 || oledPushPage >= 8) return;

  uint8_t* buf = display.getBuffer();
  int page = oledPushPage;

  oledSwSpiCmd(0xB0 | page);  // set page address
  oledSwSpiCmd(0x02);         // lower column start (SH1106 2-pixel offset)
  oledSwSpiCmd(0x10);         // upper column start

  // Pixel data — DC already HIGH from oledSwSpiCmd exit
  for (int col = 0; col < 128; col++) {
    oledSwSpiWrite(buf[page * 128 + col]);
  }

  oledPushPage++;
  if (oledPushPage >= 8) {
    oledPushPage = -1;  // transfer complete
  }
}

static inline bool oledPushInProgress() { return oledPushPage >= 0; }

// Start a chunked push and stamp the watchdog timestamp atomically.
// Replaces the 4-line oledStartPush()/noInterrupts()/stamp/interrupts() pattern.
static inline void oledStartPushAndStamp(uint32_t nowMs) {
  oledPushPage = 0;
  noInterrupts();
  lastFrameDrawTick = nowMs;
  interrupts();
}

// Display rendering — top bar, scope overlays, chroma dots, parameter overlay,
// MONOBASS sweep animation, and main updateDisplay() dispatcher.
// Depends on: all prior headers, isSafeToPushOled() (defined below).
#include "display_ui.h"

// SPI push guard — returns true when it's safe to start a chunked OLED
// page transfer (~2ms per page). Returns false if audio timing work is
// pending or imminent. Musical timing always wins over display updates.
// Called from updateDisplay() for both the PPQN mode and normal display paths.
bool isSafeToPushOled(uint32_t nowMs) {
  // Steps waiting: consume them first, never block with pending audio work
  if (pendingStepCount > 0) { return false; }

  // Drop-in display block (suppress push for 500ms after PLAY press)
  if (displayBlockedUntilTick > 0) {
    if ((int32_t)(displayBlockedUntilTick - nowMs) > 0) {
      return false;
    } else {
      displayBlockedUntilTick = 0;  // main-loop only — no interrupt guard required
    }
  }

  // Internal clock: predict next stepISR from last-fired timestamp + period
  if (transportState == RUN_INT) {
    uint32_t fired;
    uint32_t period;
    noInterrupts();
    fired  = lastStepFiredUs;
    period = intStepPeriodUs;
    interrupts();

    if (period > 0 && fired > 0) {
      int32_t remaining = (int32_t)((fired + period) - micros());
      if (remaining > 0 && remaining < OLED_GUARD_US) {
        return false;
      }
    }
  }

  // External clock: protect steps B (subdivision) and A (next pulse)
  if (transportState == RUN_EXT) {
    uint32_t subdivDue;
    uint32_t ema;
    uint32_t lastP;
    noInterrupts();
    subdivDue = subdivTimerDueUs;
    ema = extIntervalEMA;
    lastP = lastPulseMicros;
    interrupts();

    // Step B: subdivision timer due within 25ms
    // micros() called outside noInterrupts() — benign TOCTOU: a slightly later
    // timestamp only makes remaining smaller, so we err toward skipping the push.
    if (subdivDue > 0) {
      int32_t remaining = (int32_t)(subdivDue - micros());
      if (remaining > 0 && remaining < OLED_GUARD_US) return false;
    }

    // Step A: next pulse predicted within 25ms from EMA
    if (ema > 0 && lastP > 0) {
      int32_t remaining = (int32_t)((lastP + ema) - micros());
      if (remaining > 0 && remaining < OLED_GUARD_US) return false;
    }
  }

  return true;
}

// renderTopBar, renderChromaNoteSelect, renderChromaDots, renderMonoTextAnim,
// renderParameterOverlay, and updateDisplay are now in display_ui.h.
